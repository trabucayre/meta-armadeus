## conf/layer.conf
```bitbake
# We have a conf and classes directory, append to BBPATH
BBPATH .= ":${LAYERDIR}"

# We have a recipes directory, add to BBFILES
BBFILES += "${LAYERDIR}/recipes-*/*/*.bb \
			${LAYERDIR}/recipes-*/*/*.bbappend"

BBFILE_COLLECTIONS += "armadeus"
BBFILE_PATTERN_armadeus := "^${LAYERDIR}/"
BBFILE_PRIORITY_armadeus = "6"

# Let us add layer-specific bbappends which are only applied when that
# layer is included in our configuration
BBFILES += "${@' '.join('${LAYERDIR}/%s/recipes*/*/*.bbappend' % layer \
				for layer in BBFILE_COLLECTIONS.split())}"
# Add layer-specific bb files too
BBFILES += "${@' '.join('${LAYERDIR}/%s/recipes*/*/*.bb' % layer \
				for layer in BBFILE_COLLECTIONS.split())}"
```

## conf/machine/apf28.conf
```bitbake
#@TYPE: Machine
#@NAME: APF28 machine
#@DESCRIPTION: Machine configuration for the apf28 board 

require conf/machine/include/imx28.inc

# Only has DVI connector for external screen
GUI_MACHINE_CLASS = "smallscreen"

IMAGE_FSTYPES += "ubi tar.gz"

# do ubiattach /dev/ubi_ctrl -m 4
# From dmesg:
# UBI: smallest flash I/O unit:    800
# UBI: logical eraseblock size:    0x1f800 bytes
# from ubiattach stdout:
# UBI device number 0, total 857 LEBs
# MKUBIFS_ARGS = "-m 2048 -e 129024 -c 857"
MKUBIFS_ARGS = "-F -m 0x800 -e 0x1f000 -c 4247 -x lzo"

# do ubiattach /dev/ubi_ctrl -m 4
# from dmesg:
# UBI: smallest flash I/O unit:    2048
# UBI: physical eraseblock size:   131072 bytes (128 KiB)
# UBI: sub-page size:              2048
UBINIZE_ARGS = "-m 0x800 -p 0x20000"

SERIAL_CONSOLE = "115200 ttyAMA0"

KERNEL_IMAGETYPE = "uImage"
KERNEL_DEVICETREE = "imx28-apf28dev.dtb"

#UBOOT_MACHINE = "apf28_config"
```

## conf/machine/apf51.conf
```bitbake
#@TYPE: Machine
#@NAME: APF51 machine
#@DESCRIPTION: Machine configuration for the apf51 board 

require conf/machine/include/imx51.inc

# Only has DVI connector for external screen
GUI_MACHINE_CLASS = "smallscreen"

IMAGE_FSTYPES += "ubi tar.gz"

# do ubiattach /dev/ubi_ctrl -m 4
# From dmesg:
# UBI: smallest flash I/O unit:    800
# UBI: logical eraseblock size:    0x1f800 bytes
# from ubiattach stdout:
# UBI device number 0, total 857 LEBs
# MKUBIFS_ARGS = "-m 2048 -e 129024 -c 857"
MKUBIFS_ARGS = "-F -m 0x800 -e 0x1f800 -c 135301 -x lzo"

# do ubiattach /dev/ubi_ctrl -m 4
# from dmesg:
# UBI: smallest flash I/O unit:    2048
# UBI: physical eraseblock size:   131072 bytes (128 KiB)
# UBI: sub-page size:              2048
UBINIZE_ARGS = "-m 0x800 -p 0x20000 -s 512"

SERIAL_CONSOLE = "115200 ttymxc2"

#UBOOT_MACHINE = "apf51_config"
```

## conf/machine/apf6dev.inc
```bitbake
# Armadeus APF6 common variables
# Supported platform : APF6 (Solo - Dual - Quad)
PREFERRED_PROVIDER_virtual/kernel ?= "linux-imx"
#PREFERRED_VERSION_linux-apf6 ?= "4.4.6"
PREFERRED_PROVIDER_u-boot = "u-boot-armadeus"
PREFERRED_PROVIDER_virtual/bootloader = "u-boot-armadeus"

UBOOT_MAKE_TARGET = "u-boot.img SPL"
UBOOT_SUFFIX = "img"

SERIAL_CONSOLE = "115200 ttymxc3"

MACHINE_FEATURES += "pci touchscreen"

KERNEL_IMAGETYPE = "zImage"
```

## conf/machine/include/imx51.inc
```bitbake
SOC_FAMILY = "imx51"
require conf/machine/include/soc-family.inc

require conf/machine/include/tune-cortexa8.inc

PREFERRED_PROVIDER_virtual/xserver = "xserver-xorg"

# For built-in LCD, add xf86-input-tslib
XSERVER = "xserver-xorg \
           xf86-input-evdev \
           xf86-input-mouse \
           xf86-video-fbdev \
           xf86-input-keyboard"

# Default to external video, change to smallscreen for built-in LCD
GUI_MACHINE_CLASS = "smallscreen"

# Increase this everytime you change something in the kernel
MACHINE_KERNEL_PR = "r21"

# Default providers, may need to override for specific machines
PREFERRED_PROVIDER_virtual/kernel = "linux-mainline-3.13"
#PREFERRED_PROVIDER_virtual/bootloader = "u-boot-armadeus-staging"
#PREFERRED_PROVIDER_u-boot = "u-boot-armadeus-staging"

KERNEL_IMAGETYPE = "uImage"

#UBOOT_ARCH = "arm"
#UBOOT_MACHINE = "apf51_config"

UBOOT_ENTRYPOINT = "0x90008000"
UBOOT_LOADADDRESS = "0x90008000"

# Use the expected value of the ubifs filesystem's volume name in the kernel
# and u-boot.
UBI_VOLNAME = "rootfs"

#EXTRA_IMAGEDEPENDS += "u-boot"
KERNEL_EXTRA_ARGS += "LOADADDR=${UBOOT_ENTRYPOINT}"

# List common SoC features, may need to add touchscreen for specific machines
MACHINE_FEATURES = "kernel26 apm usbgadget usbhost vfat ext2 screen alsa ethernet"
```
